## drivers/misc/mediatek/sunwave/Kconfig
```kconfig
# SPDX-License-Identifier: GPL-2.0

config SUNWAVE_FP
	bool "Sunwave fingerprint sensor control"
	depends on INPUT && OF && TRUSTKERNEL_TEE_FP_SUPPORT
	help
	  /dev/sunwave_fp and the fingerprint_key input device on the
	  mediatek,fingerprint node, as the stock sunwave-fp driver, for
	  the stock Sunwave fingerprint HAL. The TrustKernel TA reads the
	  sensor over SPI0, so this only needs the TEE and the SPI0 clock.
```

## drivers/misc/mediatek/thermal/Kconfig
```kconfig
# Modem thermal: the PA thermistor zone and the modem coolers stock binds
# to it

config MTK_THERMAL_BTSMDPA
	bool "MediaTek modem PA thermistor"
	depends on THERMAL_OF && IIO
	help
	  The mtktsbtsmdpa thermal sensor: the NTC on SoC AUXADC channel 1
	  near the modem PA, read as stock's mtk_ts_btsmdpa does. The zone,
	  its trips and cooling maps come from the board DT.

config MTK_COOLER_MUTT
	bool "MediaTek modem throughput coolers"
	depends on THERMAL_OF
	help
	  The modem uplink throttling coolers mtk-cl-adp-mutt, mtk-cl-noIMS,
	  mtk-cl-mdoff and mtk-cl-mutt00 to 03, with stock's
	  /proc/driver/thermal/clmutt controls. They pass limits to the modem
	  through eccci.
```

## drivers/misc/mediatek/tkcore/Kconfig
```kconfig
# Copyright (c) 2015-2018 TrustKernel Incorporated
# All Rights Reserved.
#
# This program is free software; you can redistribute it and/or
# modify it under the terms of the GNU General Public License
# version 2 as published by the Free Software Foundation.
#
# This program is distributed in the hope that it will be useful,
# but WITHOUT ANY WARRANTY; without even the implied warranty of
# MERCHANTABILITY or FITNESS FOR A PARTICULAR PURPOSE. See the
# GNU General Public License for more details.

config TRUSTKERNEL_TEE_SUPPORT
	bool "TrustKernel Trusted Execution Environment Support"
	depends on ARM64 && !TEE
	select DMA_SHARED_BUFFER
	default n
	help
	  Enable the support of TrustKernel TEE drivers.
	  All Trustkernel related functions will depend on this option.
	  Say Y if you would like yo enable this feature.
	  If unsure, say N.

config TRUSTKERNEL_TEE_FP_SUPPORT
	bool "TrustKernel Trusted Execution Environment Finger Print Support"
	depends on TRUSTKERNEL_TEE_SUPPORT
	default n
	help
	  Enable TrustKernel TEE clock management mechanism.
	  This feature allows TEE OS to manage clock already
	  used by Linux.
	  Say Y if you would like yo enable this feature.
	  If unsure, say Y.

config TRUSTKERNEL_TEE_RPMB_SUPPORT
	bool "TrustKernel Trusted Execution Environment RPMB Support"
	depends on TRUSTKERNEL_TEE_SUPPORT
	default n
	help
	  Enable the access of Replay Protected Memory Block
	  region for Trustkernel TEE.
	  Say Y if you would like yo enable this feature.
	  If unsure, say Y.

config TRUSTKERNEL_TEE_RAM_DIAGNOSTIC
	bool "Fail closed unless stock LK shared-memory ownership is preserved"
	depends on TRUSTKERNEL_TEE_SUPPORT && OF_RESERVED_MEM && ARCH_KEEP_MEMBLOCK
	default n
	help
	  RAM diagnostic only. After secure SHM negotiation, require the fresh
	  LK tee-reserved no-map node, its early reserved-memory record and its
	  absence from mapped and reserved memblock memory before mapping the
	  exact stock relative SHM range inside it. A mismatch aborts
	  driver startup; it never reserves guessed memory or changes the reply.
	  The optional proc/debug logger is omitted to prevent its earlier log-SHM
	  mapping and IRQ/thread startup. This does not suppress the SHM negotiation
	  SMC or qualify secure internals.

config TRUSTKERNEL_TEE_DIAGNOSTIC_LOGGER
	bool "Keep /proc/tkcore and the TEE log reader under the SHM guard"
	depends on TRUSTKERNEL_TEE_RAM_DIAGNOSTIC
	default n
	help
	  With the RAM diagnostic guard on, still register /proc/tkcore and
	  run the stock OS-revision and GET_LOGM_CONFIG SMCs, log IRQ and
	  tee-log thread. The log SHM must lie inside the owned no-map TEE
	  reservation and clear of the SHM pool before it is mapped. If that
	  check or any logger step fails, only the logger is left off; the
	  /proc/tkcore version entries and the driver carry on. This brings
	  back the TEE OS log in dmesg and /proc/tkcore/tkcore_log, and the
	  teed version entry.
```

## drivers/misc/mediatek/vibrator/Kconfig
```kconfig
config MTK_VIBRATOR
	tristate "MediaTek Vibrator driver"
	depends on LEDS_CLASS && REGULATOR && OF
	help
	  The MT6358 VIBR LDO vibrator as /sys/class/leds/vibrator with the
	  stock activate, duration and state files.
```
