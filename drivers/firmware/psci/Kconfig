## drivers/firmware/psci/Kconfig
```kconfig
# SPDX-License-Identifier: GPL-2.0-only
config ARM_PSCI_FW
	bool

config ARM_PSCI_NO_SYSTEM_SUSPEND
	bool "Don't use PSCI SYSTEM_SUSPEND for suspend to RAM"
	depends on ARM_PSCI_FW && SUSPEND
	help
	  Leave PSCI SYSTEM_SUSPEND unused even when the firmware lists it,
	  so "mem" in /sys/power/state means suspend-to-idle (s2idle) only.
	  For firmware whose system suspend needs a vendor kernel driver to
	  set it up first, such as MediaTek SPM on MT6771.

config ARM_PSCI_CHECKER
	bool "ARM PSCI checker"
	depends on ARM_PSCI_FW && HOTPLUG_CPU && CPU_IDLE && !TORTURE_TEST
	help
	  Run the PSCI checker during startup. This checks that hotplug and
	  suspend operations work correctly when using PSCI.

	  The torture tests may interfere with the PSCI checker by turning CPUs
	  on and off through hotplug, so for now torture tests and PSCI checker
	  are mutually exclusive.
```

## drivers/input/keyboard/mediatek/Kconfig
```kconfig
# SPDX-License-Identifier: GPL-2.0
# MediaTek keypad (mtk-kpd), ported from the Titan Pocket 4.14 vendor kernel.

config KEYBOARD_MTK
	tristate "MediaTek Keypad Support"
	depends on OF && ARCH_MEDIATEK
	help
	  The MediaTek keypad matrix at kp@10010000, as the input device
	  mtk-kpd. With KPD_PWRKEY_USE_PMIC it also reports the MT6358
	  power and home keys.

	  To compile this driver as a module, choose M here: the
	  module will be called mtk-kpd.

if KEYBOARD_MTK

config KPD_PWRKEY_USE_PMIC
	bool "Power key from the MT6358 PMIC"
	depends on MFD_MT6397
	help
	  Report the MT6358 PWRKEY and HOMEKEY interrupts on mtk-kpd, as
	  mediatek,kpd-sw-pwrkey and mediatek,kpd-sw-rstkey.

config ONEKEY_REBOOT_NORMAL_MODE
	bool "Long press reboot by Powerkey only on normal mode"
	depends on KPD_PWRKEY_USE_PMIC

config TWOKEY_REBOOT_NORMAL_MODE
	bool "Long press reboot by Powerkey + other key on normal mode"
	depends on KPD_PWRKEY_USE_PMIC

config ONEKEY_REBOOT_OTHER_MODE
	bool "Long press reboot by Powerkey only on other mode"
	depends on KPD_PWRKEY_USE_PMIC

config TWOKEY_REBOOT_OTHER_MODE
	bool "Long press reboot by Powerkey + other key on other mode"
	depends on KPD_PWRKEY_USE_PMIC

config KPD_PMIC_LPRST_TD
	int "Long press reboot timeout period"
	depends on ONEKEY_REBOOT_NORMAL_MODE || TWOKEY_REBOOT_NORMAL_MODE
	range 0 3
	default "0"
	help
	  MT6358 RG_PWRKEY_RST_TD: 0 is 8 s, 1 is 11 s, 2 is 14 s, 3 is 5 s.

config MTK_MRDUMP_KEY
	bool "MediaTek mrdump reset key support"
	help
	  Adds KEY_RESTART to mtk-kpd and listens on the
	  "mediatek, mrdump_ext_rst-eint" node's IRQ when it has one.

endif
```

## drivers/misc/mediatek/btif/Kconfig
```kconfig
config MTK_BTIF
	tristate "MediaTek BTIF Driver"
	depends on OF && COMMON_CLK
	help
	  MTK connectivity BTIF driver for A/D die
	  and not supported in combo project
	  It is used to config whether BTIF driver
	  is supported or not.
```

## drivers/misc/mediatek/ccci_platform/Kconfig
```kconfig
# SPDX-License-Identifier: GPL-2.0

config MTK_CCCI_PLATFORM_DEPS
	bool "MT6771 platform calls for the eccci modem driver"
	depends on MACH_MT6771 && MTK_PMIC_CHIP_MT6358 && MFD_MT6397 && MEDIATEK_SOLUTION
	help
	  The calls the 4.14 eccci driver makes outside itself: VMODEM
	  through the MT6358, the clock buffer flight mode bit, the SPM
	  AP-to-MD clock source request, and logging stubs for PBM,
	  vcorefs and AEE. Same names and prototypes as 4.14.
```

## drivers/misc/mediatek/ccmni/Kconfig
```kconfig
config MTK_NET_CCMNI
	bool "MediaTek CCMNI driver"
	depends on NET
	default n
	select WIRELESS_EXT
	select WEXT_PRIV
	help
	  The ccmni network interfaces for the eccci modem driver. eccci's
	  port_net registers the interfaces through ccmni_ops.init; until
	  eccci is built, weak stubs stand in for the two port calls ccmni
	  makes back into it.
```

## drivers/misc/mediatek/conn_md/Kconfig
```kconfig
config MTK_CONN_MD
	bool "Support mtk connsys modem config"
	help
	  The conn_md bridge that passes LTE and Wi-Fi coexistence (IDC)
	  messages between the connsys WMT driver and the modem. It exports
	  mtk_conn_md_bridge_reg, _unreg and _send_msg, which the connectivity
	  stubs give instead when this is off.
```

## drivers/misc/mediatek/connectivity/Kconfig
```kconfig
# Connectivity built-in adapter (connadp) and the stock connectivity
# options from the 4.14 Kconfig, for the out-of-tree WMT, Wi-Fi, BT, GPS
# and FM modules. Only MTK_COMBO builds code here; the rest are read by the
# module Makefiles from this kernel's config, as stock.

config MTK_COMBO
	bool "MediaTek connectivity built-in adapter"
	help
	  Builds the exports the MediaTek connsys modules (wmt_drv,
	  wmt_chrdev_wifi, wlan_drv_gen3, bt_drv, gps_drv, fmradio_drv)
	  take from the kernel. Built in: the modules link against it and
	  it hooks the consys reserved memory at boot.

choice
	prompt "Select Chip"
	depends on MTK_COMBO

config MTK_COMBO_CHIP_CONSYS_6771
	bool "MTK MT6771 combo chip support"
	help
	  MT6771 connsys (BT, Wi-Fi, GPS and FM).

endchoice

config MTK_COMBO_CHIP
	string
	default "CONSYS_6771" if MTK_COMBO_CHIP_CONSYS_6771
	help
	  Combo chip or SoC connsys name the module Makefiles switch on.

config MTK_COMBO_BT
	tristate "MediaTek Combo Chip BT driver"
	depends on MTK_COMBO
	help
	  MTK BT /dev/stpbt driver, built out of tree.

config MTK_COMBO_GPS
	tristate "MediaTek Combo Chip GPS driver"
	depends on MTK_COMBO
	help
	  MTK GPS /dev/stpgps driver, built out of tree.

config MTK_COMBO_WIFI
	tristate "MediaTek combo chip Wi-Fi support"
	depends on MTK_COMBO
	select WIRELESS_EXT
	select WEXT_PRIV
	help
	  MTK gen3 Wi-Fi, built out of tree. Selects the wireless
	  extensions it uses, as stock.

config MTK_WIFI_MCC_SUPPORT
	bool "MTK_WIFI_MCC_SUPPORT"
	depends on MTK_COMBO_WIFI
	default y
	help
	  Multi-channel concurrency in the Wi-Fi driver.

config MTK_GPS_SUPPORT
	tristate "support MediaTek GPS driver"
	help
	  GPS feature switch the GPS module build reads.

config MTK_GPS_EMI
	tristate "MediaTek GPS EMI Driver"
	depends on MTK_COMBO_GPS
	help
	  GPS EMI driver for MNL offload. Off on stock.

config MTK_FMRADIO
	tristate "MediaTek FMRadio driver"
	depends on MTK_COMBO
	help
	  MTK FM radio, built out of tree.

config MTK_FM_CHIP
	string "MTK FM CHIP"
	depends on MTK_FMRADIO
	help
	  FM chip the FM module build picks, MT6631_FM on stock.
```

## drivers/misc/mediatek/cpuhp/Kconfig
```kconfig
config MTK_CPUHP_POWER_DOWN
	bool "MT6771 core and cluster power-down after CPU hotplug"
	depends on ARM64 && HOTPLUG_CPU && HAVE_ARM_SMCCC
	help
	  After a CPU goes offline, ask ATF to power its core down
	  (SIP 0xc2000212), and its cluster (SIP 0xc2000210) when it was the
	  last CPU of a cluster, as stock's cpuhotplug driver on mt6771.
	  ATF's PSCI CPU_OFF leaves the core powered, so without this an
	  offline CPU can't come back online.
```

## drivers/misc/mediatek/emi/Kconfig
```kconfig
config MTK_EMI
	bool "MT6771 EMI MPU regions"
	depends on MACH_MT6771 && MEDIATEK_SOLUTION
	help
	  Sets EMI MPU regions through ATF (SMC EMIMPU_SET), as stock's
	  emi_mpu_set_protection(): the locked AP region 31 over all of
	  DRAM at boot, and the regions SCP and the connsys modules ask
	  for. Debugfs under emi_mpu/ shows the violation status and
	  every region.
```

## drivers/misc/mediatek/flashlight/richtek/Kconfig
```kconfig
config RT_FLASHLIGHT
	bool "Richtek Flashlight Device Class"
	default n
	help
	  Say Y to enable Richtek Flashlight Device Class
	  This Framework is good for
	  controling flashlight Leds.
	  Say N to disable Richtek Flahslight Device Class


config POCKET_TORCH
	bool "Titan Pocket torch LED"
	depends on RT_FLASHLIGHT && MT6370_PMU_FLED && LEDS_CLASS
	help
	  Say Y for /sys/class/leds/torch, which lights both MT6370 flash
	  LEDs in torch mode at the stock torch currents (175 and 25 mA).
```

## drivers/misc/mediatek/i2c_shim/Kconfig
```kconfig
# SPDX-License-Identifier: GPL-2.0
config MTK_I2C_SHIM
	bool "MTK I2C extension calls over i2c-mt65xx"
	depends on I2C_MT65XX=y
	help
	  mtk_i2c_transfer, hw_trig_i2c_* and i2c_ccu_* from the 4.14 MTK
	  I2C driver, for the 4.14 camera drivers. mtk_i2c_transfer is a
	  plain i2c_transfer, hw_trig_i2c_* return -1 as stock does on a
	  bus without buffer mode and i2c_ccu_* drive i2c-mt65xx's CCU
	  channel.
```

## drivers/misc/mediatek/irtx/Kconfig
```kconfig
config MTK_IRTX_PWM_SUPPORT
	bool "MediaTek consumer IR transmitter"
	depends on MTK_PWM && REGULATOR && PINCTRL
	help
	  MediaTek IR transmitter driver on PWM memory mode, /dev/irtx,
	  for the stock consumerir HAL. It powers the IR LED from the
	  irtx-supply regulator while the device is open.
```

## drivers/misc/mediatek/mcdi_sspm/Kconfig
```kconfig
config MTK_MCDI_SSPM
	bool "MT6771 MCDI core-off through SSPM"
	depends on MTK_SSPM_IPI && ARM_PSCI_CPUIDLE && CPU_PM
	help
	  The AP side of MCDI core-off for cpuidle-psci's mcdi-cpu state:
	  the available CPU mask and the isolation mask in SSPM mailbox 3,
	  and a pause around CPU hotplug, as stock's mcdi_v1 on mt6771.
	  Off until mtk_mcdi.enable=1. Debugfs under mtk_mcdi/.
```

## drivers/misc/mediatek/pwm/Kconfig
```kconfig
config MTK_PWM
	bool "MediaTek PWM memory mode"
	depends on OF && COMMON_CLK
	help
	  MT6771 PWM block (mediatek,pwm) in memory mode: a channel sends a
	  bitstream from a DMA buffer. Only the IR transmitter uses it.
	  pwm_set_spec_config() and mt_pwm_disable() as in MediaTek's
	  driver, other modes are refused.
```

## drivers/misc/mediatek/scp/Kconfig
```kconfig
config MTK_TINYSYS_SCP_SUPPORT
	bool "MediaTek MT6771 SCP core"
	depends on MACH_MT6771 && OF_RESERVED_MEM && COMMON_CLK
	help
	  The SCP (the Cortex-M4 that runs the sensor hub) as stock: the
	  mailbox IPI, the ready notify, the awake lock, the scp_share
	  reserved memory and the SCP clock mux. LK loads the firmware.
```

## drivers/misc/mediatek/smartpa/Kconfig
```kconfig
# SPDX-License-Identifier: GPL-2.0

config MTK_SMARTPA_FS16XX_I2C
	bool "FourSemi FS16xx smart amp raw I2C device"
	depends on I2C
	help
	  /dev/smartpa_i2c on the mediatek,speaker_amp client for the
	  vendor FS16xx userspace library, as the stock foursemi driver.
	  Built in so the node exists before init's on boot chmod.
```

## drivers/misc/mediatek/smi/Kconfig
```kconfig
config MTK_SMI_EXT
	bool "MediaTek SMI Support"
	select MEMORY
	select MTK_SMI
	# The mainline mtk_smi_larb_get API is not built with SMI EXT.
	depends on !MTK_IOMMU && !MTK_IOMMU_V1 && !DRM_MEDIATEK
	help
	  This driver is for the memory controller module in MediaTek SoCs,
	  mainly help arbitrate memory bandwidth of multimedia,
	  and optimize multimedia memory usage in different scenarios.
	  If you are not sure about this, set y.
```

## drivers/misc/mediatek/spm/Kconfig
```kconfig
config MTK_SPM_BASE
	bool "MT6771 SPM base driver"
	depends on ARM64 && HAVE_ARM_SMCCC && OF
	help
	  Maps the SPM (mediatek,sleep) and sleep_reg_md, takes SPM IRQ0,
	  tells ATF the PCM firmware index and reads its firmware status, as
	  stock's spm_module_init on mt6771. Shows them in debugfs spm/status.
	  It starts no vcore DVFS and no suspend.

config MTK_SPM_VCOREFS
	bool "MT6771 vcorefs init and Vcore DVFS"
	depends on MTK_SPM_BASE
	help
	  Runs stock's vcorefs init with Vcore DVS and DRAM DFS off: the
	  SSPM QoS enable and OPP rows, the Vcore OPP table, the PCM
	  firmware's PMIC wrap entries, PCM flag 0x418 and the DVFSRC set-up,
	  then puts the pm_qos DRAM, Vcore and bandwidth requests and the
	  screen state into the DVFSRC. Vcore and DRAM stay where they are.
	  Runs unless spm_vcorefs.init=0. Debugfs spm/vcorefs and spm/qos.
	  With spm_vcorefs.dvfs=1, the default, stock's DVS and DFS on branch
	  (PCM flag 0x8400) and debugfs spm/force_opp; after a boot with
	  dvfs=0, writing 1 to it turns that branch on then, with no way back.

config MTK_SPM_SUSPEND
	bool "MT6771 SPM deep suspend"
	depends on MTK_SPM_VCOREFS && SUSPEND && ARM_PSCI_FW
	help
	  Stock's suspend for mem through the SPM: the PCM watchdog, the SSPM
	  suspend commands, the MCDI pause and the TOPRGU handover, the GIC
	  masked but for SPM IRQ0 and stock's edge IRQs, which SYS_CIRQ
	  latches while the GIC is off, the 8250_mtk sleep handshake, the SIP
	  suspend flags and PSCI CPU_SUSPEND 0x1010005 on CPU0. Then the wake
	  reason in dmesg, pm_wakeup_irq and debugfs spm/suspend. Offered as
	  mem_sleep "deep", and the default, with spm_suspend.deep=1 and
	  spm_vcorefs.init=1 (both default); mem_sleep_default=s2idle or
	  spm_suspend.deep=0 keeps s2idle.
```

## drivers/misc/mediatek/sspm_ipi/Kconfig
```kconfig
config MTK_SSPM_IPI
	bool "MT6771 SSPM mailbox and IPI core"
	depends on MACH_MT6771 && OF_RESERVED_MEM
	help
	  Talks to the SSPM power co-processor the preloader starts: maps
	  its mailboxes, checks the pin layout, sends PLT_INIT with a log
	  buffer in reserve-memory-sspm_share and exports
	  sspm_ipi_send_sync(). Loads no firmware. Debugfs under sspm/.
```
